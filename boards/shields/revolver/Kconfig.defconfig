## boards/shields/revolver/Kconfig.defconfig
```kconfig
if SHIELD_REVOLVER_LEFT

config ZMK_KEYBOARD_NAME
    default "REVOLVER"

config ZMK_SPLIT_ROLE_CENTRAL
    default y
	
config ZMK_USB
	default y

endif

if SHIELD_REVOLVER_LEFT || SHIELD_REVOLVER_RIGHT

config ZMK_SPLIT
    default y

endif

config CONFIG_ZMK_COMBO_MAX_COMBOS_PER_KEY
	default 10
```

## boards/shields/revolver/Kconfig.shield
```kconfig
config SHIELD_REVOLVER_LEFT
    def_bool $(shields_list_contains,revolver_left)

config SHIELD_REVOLVER_RIGHT
    def_bool $(shields_list_contains,revolver_right)
```
