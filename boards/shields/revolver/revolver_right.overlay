//based on https://github.com/zmkfirmware/zmk/blob/main/app/boards/shields/cradio/cradio_right.overlay

#include "revolver.dtsi"

zmk,matrix-transform = &default_transform;

&default_transform { 
    col-offset = <6>;
};