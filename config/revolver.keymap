// based on https://github.com/zmkfirmware/zmk/blob/main/app/boards/shields/cradio/cradio.keymap
// and https://github.com/christianselig/caldera-keyboard/blob/main/zmk-config-caldera/config/caldera.keymap

#include <behaviors.dtsi>
#include <dt-bindings/zmk/keys.h>
#include <dt-bindings/zmk/bt.h>
#include <dt-bindings/zmk/pointing.h>

#define NUMLAYER 1
#define nk0 8
#define nk1 0
#define nk2 1
#define nk3 2
#define nk4 3
#define nk5 6

#define SYMLAYER 2

#define FUNCLAYER 3

#define MOUSELAYER 4

#define lkP 0 //pinky
#define lkR 1 //ring
#define lkM 2 //middle
#define lkI 3 //index
#define lmP 5 //pinky
#define lmR 4 //ring
#define rkI 6
#define rkM 7
#define rkR 8
#define rkP 9
#define rmP 11 //pinky
#define rmR 10 //ring

#define CAD_ESC      &mt LC(LA(DEL)) ESC      //hold: control alt delete | tap: escape
#define AS(keycode) &am LS(keycode) keycode
#define AC(keycode) &am LC(keycode) keycode
#define AA(keycode) &am LA(keycode) keycode
#define ASC(keycode) &am LS(LC(keycode)) keycode
#define ASA(keycode) &am LS(LA(keycode)) keycode
//#define HC(keycode) &hm keycode LCTRL
//#define HA(keycode) &hm keycode LALT

// COMBO(one, &kp N1, 0 10, 0)
#define COMBO(NAME, BINDINGS, KEYPOS, LAYERS) \
  combo_##NAME { \
    timeout-ms = <100>; \
    bindings = <BINDINGS>; \
    key-positions = <KEYPOS>; \
    layers = <LAYERS>; \
  };
	
/*#define GET_MACRO(_1,_2,_3,_4,NAME,...) NAME
#define TAPDANCE(...) GET_MACRO(__VA_ARGS__, TAPDANCE4, TAPDANCE3, TAPDANCE2)(__VA_ARGS__)
#define TAPDANCE2(NAME, BINDING1, BINDING2, TAPTERM) \
	td_##NAME: tap_dance_##NAME { \
		compatible = "zmk,behavior-tap-dance"; \
		#binding-cells = <0>; \
		tapping-term-ms = <TAPTERM>; \
		bindings = <BINDING1>, <BINDING2>; \
	};
#define TAPDANCE3(NAME, BINDING1, BINDING2, BINDING3, TAPTERM) \
	td_##NAME: tap_dance_##NAME { \
		compatible = "zmk,behavior-tap-dance"; \
		#binding-cells = <0>; \
		tapping-term-ms = <TAPTERM>; \
		bindings = <BINDING1>, <BINDING2>, <BINDING3>; \
	};
#define TAPDANCE4(NAME, BINDING1, BINDING2, BINDING3, BINDING4, TAPTERM) \
	td_##NAME: tap_dance_##NAME { \
		compatible = "zmk,behavior-tap-dance"; \
		#binding-cells = <0>; \
		tapping-term-ms = <TAPTERM>; \
		bindings = <BINDING1>, <BINDING2>, <BINDING3>, <BINDING4>; \
	};*/
#define TAPDANCE5(NAME, BINDING1, BINDING2, BINDING3, BINDING4, BINDING5, TAPTERM) \
	td_##NAME: tap_dance_##NAME { \
		compatible = "zmk,behavior-tap-dance"; \
		#binding-cells = <0>; \
		tapping-term-ms = <TAPTERM>; \
		bindings = <BINDING1>, <BINDING2>, <BINDING3>, <BINDING4>, <BINDING5>; \
	};
#define S_C_A_SC_SA_TD(keycode) TAPDANCE5(SCASCSA##keycode, AC(keycode), AS(keycode), AA(keycode), ASC(keycode), ASA(keycode), 150)
#define MODTD(keycode) &td_SCASCSA##keycode

// | SW00 | SW01 | SW02 | SW03 | | SW06 | SW07 | SW08 | SW09 |
// | SW04 | SW05 |                             | SW10 | SW11 |
//  ---------------------------------------------------------
// | G    | N    | A    | E    | | T    | O    | R    | G    |
// | SPC  | DOT  |                             | RET  | BSPC |

/ {
    macros {
        bt_discnxt: bt_discnxt {
            compatible = "zmk,behavior-macro";
            #binding-cells = <0>;
            bindings
                = <&macro_tap &bt BT_NXT &bt BT_DISC 0 &bt BT_DISC 1 &bt BT_DISC 2 &bt BT_DISC 4>
                ;
        };
	bt_discprv: bt_discprv {
            compatible = "zmk,behavior-macro";
            #binding-cells = <0>;
            bindings
                = <&macro_tap &bt BT_PRV &bt BT_DISC 0 &bt BT_DISC 1 &bt BT_DISC 2 &bt BT_DISC 4>
                ;
        };
	bt_disc: bt_disc {
            compatible = "zmk,behavior-macro";
            #binding-cells = <0>;
            bindings
                = <&macro_tap &bt BT_DISC 0 &bt BT_DISC 1 &bt BT_DISC 2 &bt BT_DISC 4>
                ;
        };
    };

    combos {
        compatible = "zmk,combos";
		COMBO(c_S, AS(S), lkI rkI, 0)		//	SET
		COMBO(c_I, AS(I), lkM rkM, 0)		//	AOI
		COMBO(c_H, AS(H), lkM lkI, 0)		//	HAE
		COMBO(c_D, AS(D), rkI rkM, 0)		//	DOT
		COMBO(c_Y, AS(Y), rkM rkR rkP, 0)	//	ORLY
		COMBO(c_U, AS(U), lkM lkR lkP, 0)	//	GNAU
		COMBO(c_C, AS(C), rkM rkR, 0)		//	COR
		COMBO(c_M, AS(M), lkR lkM, 0)		//	MAN
		COMBO(c_F, AS(F), lkR rkR, 0)		//	FRN
		COMBO(c_P, AS(P), rkI rkM rkR, 0)	//	PORT
		COMBO(c_W, AS(W), lkR lkM rkM rkR, 0)	//	NARROW
		COMBO(c_B, AS(B), lkM lkI rkI rkM, 0)	//	BAETO
		COMBO(c_V, AS(V), lkP lkR, 0)		//	VEGAN
		COMBO(c_K, AS(K), rkR rkP, 0)		//	KURD
		COMBO(c_J, AS(J), lkI lkP lkR lkM, 0)	//	JGNAE
		COMBO(c_X, AS(X), rkI rkM rkR rkP, 0)	//	XTORU
		COMBO(c_Z , AS(Z), lkP lkR rkR rkP, 0)	//	Z OUTER FOUR
		COMBO(c_Q, AS(Q), lkP lkR lkM rkM rkR rkP, 0)	//Q OUTER SIX
		
		//COMBO(c_SPCDOT, &mt SPACE DOT, rkR rkP, 0)
		COMBO(c_TAB, AS(TAB), rkM rkR rkP, 0)
		//COMBO(c_COMMA, &kp COMMA, lkP lkR, 0)
		COMBO(c_QMARK, &kp QMARK, lkI rkP, 0)
		//COMBO(c_EXCL, &kp EXCL, lkP lkI, 0)
		//COMBO(c_SQT, &kp SQT, lkP lkR lkI, 0)

		COMBO(cadesc, CAD_ESC, rkP rmP, 0 1 2 3)
		
		COMBO(numLayer, &mo NUMLAYER, rmR rmP, 0 1)
		COMBO(c_n6,  AS(N6), nk1 nk5, 1)
		COMBO(c_n6b, AS(N6), nk2 nk4, 1)
		COMBO(c_n7,  AS(N7), nk2 nk5, 1)
		COMBO(c_n7b, AS(N7), nk3 nk4, 1)
		COMBO(c_n8,  AS(N8), nk3 nk5, 1)
		COMBO(c_n9,  AS(N9), nk4 nk5, 1)
		//combo_numTest { timeout-ms = <200>; lkIy-positions = <3 6>; bindings = <&kp N9>; layers = <1>; };
		
		COMBO(c_symLayer, &mo SYMLAYER, lmP lkP, 0)
		
		//combo_funcLayer { timeout-ms = <50>; lkIy-positions = <rmP rmR>; bindings = <&mo FUNCLAYER>; };
		
		COMBO(c_bluetoothNext, &bt BT_NXT, rmP lmR, 0)
		COMBO(c_bluetoothPrev, &bt BT_PRV, rmR lmP, 0)
		COMBO(c_bluetoothDisc, &bt_disc, lmR lmP rmP, 0)
		
		COMBO(c_mouseLayer, &to MOUSELAYER, lmP lmR, 0)
		COMBO(c_baseLayer, &to 0, lmP lmR, MOUSELAYER)
		
		//delete
		//arrow keys
		//brackets
		//slashes
		//colon
		//function
		//os
		//mods
    };
		
	behaviors {
		skq: sticky_key_quick_release {
			compatible = "zmk,behavior-sticky-key";
			#binding-cells = <1>;
			bindings = <&kp>;
			release-after-ms = <5000>;
			quick-release;
			lazy;
			ignore-modifiers;
		};
		
		am: auto_mod {
			compatible = "zmk,behavior-hold-tap";
			label = "AUTO_MOD";
			#binding-cells = <2>;
			tapping_term_ms = <180>;
			quick_tap_ms = <50>;
			flavor = "tap-preferred";
			bindings = <&kp>, <&kp>;
		};
		
		hm: hold_mod {
			compatible = "zmk,behavior-hold-tap";
			label = "HOLD_MOD";
			#binding-cells = <2>;
			tapping_term_ms = <180>;
			quick_tap_ms = <50>;
			flavor = "tap-preferred";
			bindings = <&skq>, <&kp>;
		};
		
		S_C_A_SC_SA_TD(A)
	};
	
	keymap {
		compatible = "zmk,keymap";

		default_layer {
			bindings = <
				AS(G)
				AS(N)
				AS(A)
				AS(E)
				&mt RET SPACE
				&mt RET SPACE
				
				AS(T)
				AS(O)
				AS(R)
				AS(L)
				AS(SQT)
				&mt DEL BSPC
			>;
		};

		number_layer {
			bindings = <
				AS(N1)
				AS(N2)
				AS(N3)
				AS(N4)
				&hm LALT LA(TAB) 
				&hm LCTRL LC(TAB)
				
				AS(N5)
				AS(N0)
				&kp A
				&kp B
				&trans
				&trans 
			>;
		};

		symbol_layer {
			bindings = <
				&trans
				AS(MINUS)
				AS(EQUAL)
				AS(SLASH)
				AS(BSLH)
				&trans

				&mt LT LPAR
				&mt GT RPAR
				AS(LBKT)
				AS(RBKT)
				AS(SEMI)
				AS(GRAVE)
			>;
		};

		function_layer {
			bindings = <
				&mt N1 EXCL
				&mt N2 AT
				&mt N3 HASH
				&mt N4 DLLR
				&kp SPACE
				&kp TAB	
				&mt N5 PRCT
				&mt N0 RPAR
				&kp A
				&kp B
				&none
				CAD_ESC
			>;
		};

		mouse_layer {
			bindings = <
				&kp LEFT
				&kp DOWN
				&msc SCRL_DOWN
				&msc SCRL_UP
				&kp UP
				&kp RIGHT
				
				&mkp MB1
				&mkp MB2
				&mmv MOVE_UP
				&mmv MOVE_RIGHT
				&mmv MOVE_DOWN
				&mmv MOVE_LEFT
			>;
		};
	};
};
